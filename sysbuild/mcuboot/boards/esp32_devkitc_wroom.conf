## sysbuild/mcuboot/boards/esp32_devkitc_wroom.conf
```kconfig
#===================================================================================================
# Copy/Paste from ~/zephyrproject/bootloader/mcuboot/boot/zephyr/prj.conf
#===================================================================================================
CONFIG_PM=n

CONFIG_MAIN_STACK_SIZE=10240
CONFIG_MBEDTLS_CFG_FILE="mcuboot-mbedtls-cfg.h"

CONFIG_BOOT_SWAP_SAVE_ENCTLV=n
CONFIG_BOOT_ENCRYPT_IMAGE=n

#CONFIG_BOOT_UPGRADE_ONLY=n
CONFIG_BOOT_BOOTSTRAP=n

### mbedTLS has its own heap
# CONFIG_HEAP_MEM_POOL_SIZE is not set

### We never want Zephyr's copy of tinycrypt.  If tinycrypt is needed,
### MCUboot has its own copy in tree.
# CONFIG_TINYCRYPT is not set
# CONFIG_TINYCRYPT_ECC_DSA is not set
# CONFIG_TINYCRYPT_SHA256 is not set

CONFIG_FLASH=y

### Various Zephyr boards enable features that we don't want.
# CONFIG_BT is not set
# CONFIG_BT_CTLR is not set
# CONFIG_I2C is not set

CONFIG_LOG=y
CONFIG_LOG_MODE_MINIMAL=y # former CONFIG_MODE_MINIMAL
### Ensure Zephyr logging changes don't use more resources
CONFIG_LOG_DEFAULT_LEVEL=3
### Decrease footprint by ~4 KB in comparison to CBPRINTF_COMPLETE=y
CONFIG_CBPRINTF_NANO=y
### Use the minimal C library to reduce flash usage
CONFIG_MINIMAL_LIBC=y


#===================================================================================================
# Copy/Paste from ~/zephyrproject/bootloader/mcuboot/boot/zephyr/boards/esp32_devkitc_wroom.conf
#===================================================================================================

# SPDX-FileCopyrightText: 2023 Espressif Systems (Shanghai) CO LTD
# SPDX-License-Identifier: Apache-2.0

CONFIG_BOOT_MAX_IMG_SECTORS=512
CONFIG_BOOT_UPGRADE_ONLY=y
#CONFIG_BOOT_VALIDATE_SLOT0=n
CONFIG_BOOT_SIGNATURE_TYPE_NONE=y
CONFIG_BOOT_BANNER=n

CONFIG_UART_CONSOLE=y
CONFIG_CONSOLE=y
CONFIG_SERIAL=y
CONFIG_BOOT_BANNER=y
CONFIG_BOOT_BANNER_STRING="Booting Zephyr OS build"

CONFIG_DEBUG=n

#CONFIG_HEAP_MEM_POOL_SIZE=512

CONFIG_BOOT_SIGNATURE_TYPE_RSA=y
CONFIG_BOOT_SIGNATURE_TYPE_RSA_LEN=256
CONFIG_BOOT_VALIDATE_SLOT0=y
#CONFIG_BOOT_SWAP_USING_SCRATCH=y
```
